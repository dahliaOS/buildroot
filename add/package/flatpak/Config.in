## add/package/flatpak/Config.in
```kconfig
config BR2_PACKAGE_FLATPAK
	bool "flatpak"
	depends on !BR2_STATIC_LIBS # ostree, libfuse
	depends on !BR2_TOOLCHAIN_USES_MUSL # ostree
	depends on BR2_INSTALL_LIBSTDCPP
	depends on BR2_PACKAGE_LIBGPG_ERROR_ARCH_SUPPORTS # libgpgme, libgpg-error
	depends on BR2_TOOLCHAIN_HAS_THREADS # ostree, glib2
	depends on BR2_USE_MMU # ostree, e2fsprogs, libfuse, libgpgme, glib2
	depends on BR2_USE_WCHAR # ostree, glib2
	select BR2_PACKAGE_APPSTREAM_GLIB
	select BR2_PACKAGE_GDK_PIXBUF # appstream-glib
	select BR2_PACKAGE_JSON_GLIB # appstream-glib
	select BR2_PACKAGE_LIBARCHIVE
	select BR2_PACKAGE_LIBCAP
	select BR2_PACKAGE_LIBGLIB2 # json-glib appstream-glib
	select BR2_PACKAGE_LIBGPGME
	select BR2_PACKAGE_LIBOSTREE
	select BR2_PACKAGE_LIBSOUP
	select BR2_PACKAGE_LIBYAML # appstream-glib
	select BR2_PACKAGE_LIBXML2
	select BR2_PACKAGE_POLKIT
	select BR2_PACKAGE_XLIB_LIBXAU
	select BR2_PACKAGE_XORGPROTO # libXau
	select BR2_PACKAGE_XUTIL_UTIL_MACROS # libXau
	help
	  Flatpak is a system for building, distributing, and running sandboxed
	  desktop applications on Linux.

	  https://github.com/flatpak/flatpak

comment "flatpak needs a toolchain w/ C++, threads, dynamic library, wchar"
	depends on !BR2_TOOLCHAIN_HAS_THREADS || BR2_STATIC_LIBS \
	  || !BR2_USE_WCHAR || BR2_TOOLCHAIN_USES_MUSL \
	  || !BR2_INSTALL_LIBSTDCPP
	depends on BR2_PACKAGE_LIBGPG_ERROR_ARCH_SUPPORTS
	depends on BR2_USE_MMU
```

## add/package/pangolin_desktop/Config.in
```kconfig
config BR2_PACKAGE_PANGOLIN_DESKTOP
        bool "pangolin_desktop"
        help
          Default desktop for dahliaOS. Requires Flutter SDK to be installed on host system.

	  https://github.com/dahliaOS/pangolin-desktop
```

## add/package/system_recovery/Config.in
```kconfig
config BR2_PACKAGE_SYSTEM_RECOVERY
        bool "system_recovery"
        help
          Recovery shell for dahliaOS. Should not be included in the standard desktop release. This package should only be used with the dahliaOS_recovery_x64_defconfig board configuration.

	  https://github.com/dahliaOS/system_recovery
```

## external/Config.in
```kconfig
source "$BR2_EXTERNAL/package/python-pip/Config.in"
source "$BR2_EXTERNAL/package/python-wheel/Config.in"
```

## external/configs/docker_python2_defconfig
```kconfig
BR2_x86_64=y
BR2_TOOLCHAIN_BUILDROOT_GLIBC=y
BR2_TARGET_GENERIC_HOSTNAME="Advanced Climate Systems"
BR2_TARGET_GENERIC_ISSUE="advancedclimate.nl"
BR2_ROOTFS_OVERLAY="/root/buildroot/rootfs_overlay"
BR2_PACKAGE_PYTHON=y
BR2_PACKAGE_PYTHON_READLINE=y
BR2_PACKAGE_CA_CERTIFICATES=y
BR2_PACKAGE_OPENSSL=y
BR2_PACKAGE_OPENSSL_BIN=y
BR2_PACKAGE_PYTHON_PIP=y
BR2_PACKAGE_PYTHON_WHEEL=y
```

## external/configs/docker_python3_defconfig
```kconfig
BR2_x86_64=y
BR2_TOOLCHAIN_BUILDROOT_WCHAR=y
BR2_PACKAGE_PYTHON3=y
BR2_PACKAGE_PYTHON3_READLINE=y
BR2_PACKAGE_PYTHON3_SSL=y
BR2_PACKAGE_PYTHON3_PYEXPAT=y
BR2_PACKAGE_CA_CERTIFICATES=y
BR2_PACKAGE_OPENSSL_BIN=y
```

## external/package/python-pip/Config.in
```kconfig
config BR2_PACKAGE_PYTHON_PIP
    bool "python-pip"
    select BR2_PACKAGE_PYTHON_PYEXPAT 
    select BR2_PACKAGE_PYTHON_SETUPTOOLS
    depends on BR2_PACKAGE_PYTHON
    help
      The PyPA recommended tool for installing Python packages.

      https://pip.pypa.io/en/stable/index.html
```

## external/package/python-wheel/Config.in
```kconfig
config BR2_PACKAGE_PYTHON_WHEEL
    bool "python-wheel"
    depends on BR2_PACKAGE_PYTHON || BR_PACKAGE_PYTHON3
    help
      A built-package format for Python.

      http://wheel.readthedocs.org/en/latest/
```

## package/dap/Config.in
```kconfig
config BR2_PACKAGE_DAP
        bool "dap"
        help
          Package manager for dahliaOS

	  https://github.com/dahliaOS/dap
```

## temp/buildroot-master/package/appstream-glib/Config.in
```kconfig
config BR2_PACKAGE_APPSTREAM_GLIB
	bool "appstream-glib"
	depends on !BR2_STATIC_LIBS # glib2
	depends on BR2_TOOLCHAIN_HAS_THREADS # glib2
	depends on BR2_USE_MMU # glib2
	depends on BR2_USE_WCHAR # glib2
	select BR2_PACKAGE_GDK_PIXBUF
	select BR2_PACKAGE_JSON_GLIB
	select BR2_PACKAGE_LIBARCHIVE
	select BR2_PACKAGE_LIBGLIB2
	select BR2_PACKAGE_LIBSOUP
	select BR2_PACKAGE_LIBYAML
	select BR2_PACKAGE_LIBICONV if !BR2_ENABLE_LOCALE # gdk-pixbuf
	help
	  AppStream-GLib is a library providing serialization and
	  deserialization support for the AppStream metadata format.

	  https://github.com/hughsie/appstream-glib

comment "appstream-glib needs a toolchain w/ wchar, threads, dynamic library"
	depends on BR2_USE_MMU
	depends on !BR2_USE_WCHAR || !BR2_TOOLCHAIN_HAS_THREADS || BR2_STATIC_LIBS
```
